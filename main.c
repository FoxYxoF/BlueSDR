#include "main.h"
#include "init.h"
#include "it.h"
#include "ILI9341_GFX.h"
#include "si5351.h"

extern arm_cfft_instance_q15 cfft;           // Структура состояний для arm_cfft_q15
extern q15_t complex_in_fft[512];            // Входной массив для БПФ{re, im, re, im...}
extern uint16_t fft_size;                    // Размер массива FFT
uint16_t out_mag_fft[256];                   // Выход с реальными уровнями
uint16_t s_metr = 100;

extern uint32_t   main_frec;
extern uint16_t   step;                        // Шаг перестройки
extern int16_t    cal_si;                      // Калибровка si
extern bool       fft_arr_fl;                  // Флаг заполнения массива	
extern bool       menu_fl;                     // Флаг фхода в меню
extern bool       sub_menu_fl;                 // Флаг фхода в подменю
// Инициализация переменных навигации (начинаем с Главного меню, 0-й строки)
extern uint8_t current_menu;
extern uint8_t current_submenu;
//extern bool       a_b_frec;                  // частота A(0), B(1)
//extern uint8_t    band_idx;                  // Текущий диапазон
//extern uint32_t   bands_frec_a[];            // Диапазоны частота
//extern uint32_t   bands_frec_b[];            // Диапазоны частота
extern trx_state_t trx_state;                  // Текущее состояние трансивера
extern trx_state_f trx_state_flag;             // Флаги состояния трансивера

extern q15_t s_peak;                           // Значения для с-метра
extern uint8_t code_button; 
extern char txt_butt[32];
extern bool rx_tx_fl;

// Значения уменьшены, чтобы максимум был 32767
const q15_t hamming_window_256[256] = {
    2313, 2317, 2329, 2348, 2376, 2410, 2454, 2504, 2561, 2627, 2700, 2781, 2868, 2963, 3066, 3175, 
    3292, 3415, 3546, 3683, 3827, 3978, 4135, 4299, 4470, 4646, 4829, 5018, 5214, 5414, 5621, 5834, 
    6052, 6275, 6504, 6739, 6978, 7222, 7471, 7725, 7983, 8246, 8513, 8784, 9059, 9338, 9621, 9907, 
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    3175, 3066, 2963, 2868, 2781, 2700, 2627, 2561, 2504, 2454, 2410, 2376, 2348, 2329, 2317, 2313
};

const uint16_t cic3_comp_256[256] = {
    256, 256, 256, 256, 256, 256, 257, 257, 257, 258, 258, 258, 259, 259, 260, 260,
    261, 262, 262, 263, 264, 265, 265, 266, 267, 268, 269, 270, 271, 273, 274, 275,
    276, 278, 279, 280, 282, 284, 285, 287, 289, 290, 292, 294, 296, 298, 300, 302,
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    262, 261, 260, 260, 259, 259, 258, 258, 258, 257, 257, 257, 256, 256, 256, 256
};

// Функция перевода амплитуды Q15 в значение для пикселя водопада (0-255)
uint8_t magnitude_to_db_pixel(q15_t mag) {
    if (mag <= 0) return 0;

    // Вариант А: Использование стандартной библиотеки (точнее, но медленнее)
    // Переводим в float (0..1), берем лог, нормируем под экран
    float float_mag = (float)mag / 32767.0f;
    float db = 20.0f * log10f(float_mag + 1e-6f); // +1e-6 чтобы не было log(0)
    
    // Обычно диапазон водопада — это последние 60-80 дБ
    // Сдвигаем и масштабируем результат в 0..255 для отрисовки
    int16_t pixel = (int16_t)(db + 80) * 3; // Пример: -80дБ -> 0, 0дБ -> 240
    
    if (pixel < 0) return 0;
    if (pixel > 255) return 255;
    return (uint8_t)pixel;
}

int main(void) {
	
	SysTick_Setup();               // Настройка системного таймера
  GPIO_Init();   	               // инициализация портов ввода вывода
	
 	TRX_State_Load();              // Загрузка из флеш последнего состояния
	
	SPI2_init();                   // инициализация SPI
  PWM2_Init();                   // Инициализация шим
  PWM3_Init();                   // Инициализация шим
	TIM4_Init();                   // инициализация таймера 4 для массивов преобразования Гилберта и ФНЧ
	ADC_DMA_Init();
 
  I2C1_Init();                   // Инициализация I2C1


	si5351_Init(cal_si);
	si5351_SetFrec(trx_state.vfo_a_freq[trx_state.current_band]<<2);// Запустили текущую частоту
  Set_mode();                    // Установка режима модуляции из trx_state
	DSP_init();                    // Инициализация DSP
	arm_cfft_init_256_q15(&cfft);  // БПФ для водопада	
	
	ADC2->CR2 |= ADC_CR2_SWSTART;	 // Стартуем ацп
	ADC1->CR2 |= ADC_CR2_SWSTART;  //	
	TIM4->CR1 |= TIM_CR1_CEN;      // Стартуем преобразование гилберта и фнч	
	
	TIM1_Encoder_Init();           // Инициализация энкодера
	GPIO_Init_Buttons();           // Инициализация кнопок	

	/////////////////////////////////////////////////////////////////////////////////////////////////////////////////
	ILI9341_Init(); // инициализация дисплея
	//ILI9341_Set_Rotation(SCREEN_HORIZONTAL_2); // установка ориентации экрана (варианты в файле ILI9341_GFX.h) для ILI9341
	ILI9341_Set_Rotation(SCREEN_HORIZONTAL_1); // установка ориентации экрана (варианты в файле ILI9341_GFX.h) для ST7789
	/////////////////////////// далее демонстрируются различные пользовательские функции ////////////////////////////
	Main_Scren_Init(); // Отрисовываем главный экран
			if (rx_tx_fl==0) {                   // RX/TX
				ILI9341_WriteString( 46, 108, "R", Font_16x26, GREEN, MYFON); // RX/TX
				RX_Device_Inint();
			}
			else {
				ILI9341_WriteString( 46, 108, "T", Font_16x26, GREEN, MYFON); // RX/TX
				TX_Device_Inint();
			}	/**/
	PWR_Init();          // Инициализация контроля питания	
	while(1) {		
	  if (fft_arr_fl) // если массив для бпф заполнен делаем преобразование и выводим
	  {
			for (int i = 0; i < 256; i++) {
        q15_t w = hamming_window_256[i];
        complex_in_fft[i<<1]       = (q15_t)(((q31_t)complex_in_fft[i<<1]       * w) >> 15);
        complex_in_fft[(i<<1) + 1] = (q15_t)(((q31_t)complex_in_fft[(i<<1) + 1] * w) >> 15);
      }
			
			arm_cfft_q15(&cfft, complex_in_fft, 0, 1);
			//arm_cmplx_mag_q31(complex_in_fft, out_mag_fft, 256);  

			for (int j = 0; j < 256; j++) {
					// Извлекаем Real и Imaginary компоненты
					int32_t re = complex_in_fft[(j << 1)];
					int32_t im = complex_in_fft[(j << 1) + 1];
					
					// Берем модуль (абсолютное значение)
					if (re < 0) re = -re;
					if (im < 0) im = -im;
					
					// Линейное приближение вектора (метод Alpha-Beta)
					int32_t max_val = (re > im) ? re : im;
					int32_t min_val = (re > im) ? im : re;
					int32_t mag = max_val + ((min_val * 3) >>3); // Результат лежит в диапазоне 0...32767
				
					// === Цифровая компенсация завала CIC-фильтра ===
					// Умножаем на q8 коэффициент и сдвигаем на 8 бит. 
					// Так как макс. mag = 32767, а макс. коэф = 768, промежуточное произведение 
					// уложится в ~25 000 000, что идеально заходит в рамки signed int32_t.
					mag = (mag * cic3_comp_256[j]) >> 8;					
					// Ограничение под палитру (clipping)
					if (mag > 255) mag = 255;	
					// Записываем чистые 256 градаций
					out_mag_fft[j] = (q15_t)mag;
			}/**/

			ILI9341_Draw_Waterfall(out_mag_fft); // выводим строку водопада
			//ILI9341_Draw_Waterfall(complex_in_fft); // выводим строку водопада
			fft_arr_fl = false; // массив готов к заполнению //
      
	  }
	  else
	  {
			//ILI9341_Draw_MainFrec(TIM1->CNT);
		  ILI9341_Draw_Smetr(s_peak); // выводим показометр
			s_peak = 0;
			
				if(!menu_fl){ // Если не в меню
					if (trx_state_flag.volume_enabled){           // Если регулируем громкость
						int32_t tmp = trx_state.volume;
						if (Process_Encoder(&tmp, 1, 0, 100)){ // Если энкодер крутили
							trx_state.volume = tmp;
							ILI9341_Draw_Menu_Var( 46+11*9, 108 + 26 + 18, trx_state.volume);
						}
					} else
					if (!trx_state.active_vfo) {      						// VFO A
						if (Process_Encoder(&trx_state.vfo_a_freq[trx_state.current_band], trx_state.tuning_step, 0, 30000000)) { // Если частота изменилась
							// Этот блок выполнится только при повороте ручки
							ILI9341_Draw_MainFrec(78, 108, trx_state.vfo_a_freq[trx_state.current_band]);
							si5351_SetFrec(trx_state.vfo_a_freq[trx_state.current_band]<<2);
						}
					}
					else {     	                                   // VFO B
						if (Process_Encoder(&trx_state.vfo_b_freq[trx_state.current_band], trx_state.tuning_step, 0, 30000000)) { // Если частота изменилась
							// Этот блок выполнится только при повороте ручки
							ILI9341_Draw_MainFrec(78, 108, trx_state.vfo_b_freq[trx_state.current_band]);
							si5351_SetFrec(trx_state.vfo_b_freq[trx_state.current_band]<<2);
						}
					}
				}
				else{ // Если в основном меню
					if(sub_menu_fl){ // Если в подменю
						//DrawVarMenu(current_menu, current_submenu);
						Menu_Enc(current_menu, current_submenu);
					}	
				}
			
	  }	
	}
}


